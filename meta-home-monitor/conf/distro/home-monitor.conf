## meta-home-monitor/conf/distro/home-monitor.conf
```bitbake
# =============================================================
# home-monitor.conf — Custom distribution for Home Monitor OS
#
# This replaces DISTRO="poky" with a product-specific distro
# that controls all system policy in one place.
# =============================================================

DISTRO = "home-monitor"
DISTRO_NAME = "Home Monitor OS"
DISTRO_VERSION = "1.0.0"
DISTRO_CODENAME = "phase1"

# Maintainer
MAINTAINER = "vinu@engineer.com"

# --- System fundamentals ---
DISTRO_FEATURES = " \
    ipv4 \
    ipv6 \
    wifi \
    systemd \
    usrmerge \
    seccomp \
    pam \
    nfs \
    zeroconf \
    "

# Remove sysvinit backfill — we use systemd exclusively
DISTRO_FEATURES_BACKFILL_CONSIDERED = "sysvinit"

# --- Init system ---
VIRTUAL-RUNTIME_init_manager = "systemd"
VIRTUAL-RUNTIME_initscripts = "systemd-compat-units"
VIRTUAL-RUNTIME_login_manager = "shadow-base"

# --- Boot: U-Boot for A/B OTA partition switching (ADR-0008) ---
RPI_USE_U_BOOT = "1"

# --- Package management ---
PACKAGE_CLASSES = "package_deb"

# --- Licensing ---
LICENSE_FLAGS_ACCEPTED = "synaptics-killswitch commercial"

# --- Image defaults ---
# No debug tweaks by default — dev images add them explicitly
EXTRA_IMAGE_FEATURES ?= ""

# --- Build reproducibility ---
INHERIT += "create-spdx"
INHERIT += "rm_work"
# Keep image deploy artifacts (ext4.gz needed for SWU packaging)
RM_WORK_EXCLUDE += "home-monitor-image home-monitor-image-dev home-monitor-image-prod home-camera-image home-camera-image-dev home-camera-image-prod"

# --- Version pinning for critical packages ---
PREFERRED_VERSION_linux-raspberrypi = "6.6%"
PREFERRED_VERSION_python3 = "3.12%"
PREFERRED_VERSION_openssl = "3.5%"

# --- FFmpeg: use upstream 6.1.4 from poky instead of rpidistro-ffmpeg 4.3.4 ---
# rpidistro-ffmpeg 4.3 cannot probe raw H.264 streams (fails with
# "unspecified size") and lacks RTSP muxer TLS options (-tls_cert/-tls_key).
# Upstream ffmpeg 6.1.4 fixes both issues. The RPi-specific patches in
# rpidistro (MMAL, sand format) are not needed — we use libcamera-vid for
# capture and ffmpeg only does stream copy.
PREFERRED_PROVIDER_ffmpeg = "ffmpeg"
PREFERRED_PROVIDER_libav = "ffmpeg"
PREFERRED_PROVIDER_libpostproc = "ffmpeg"
BBMASK += "meta-raspberrypi/recipes-multimedia/rpidistro-ffmpeg"

# --- Disk space monitor ---
BB_DISKMON_DIRS ??= "\
    STOPTASKS,${TMPDIR},1G,100K \
    STOPTASKS,${DL_DIR},1G,100K \
    STOPTASKS,${SSTATE_DIR},1G,100K \
    STOPTASKS,/tmp,100M,100K \
    HALT,${TMPDIR},100M,1K \
    HALT,${DL_DIR},100M,1K \
    HALT,${SSTATE_DIR},100M,1K \
    HALT,/tmp,10M,1K"
```

## meta-home-monitor/conf/layer.conf
```bitbake
# Layer configuration for meta-home-monitor
BBPATH .= ":${LAYERDIR}"

BBFILES += " \
    ${LAYERDIR}/recipes-*/*/*.bb \
    ${LAYERDIR}/recipes-*/*/*.bbappend \
    "

BBFILE_COLLECTIONS += "home-monitor"
BBFILE_PATTERN_home-monitor = "^${LAYERDIR}/"
BBFILE_PRIORITY_home-monitor = "10"

LAYERDEPENDS_home-monitor = " \
    core \
    meta-python \
    networking-layer \
    multimedia-layer \
    webserver \
    raspberrypi \
    "
LAYERSERIES_COMPAT_home-monitor = "scarthgap"
```

## meta-home-monitor/recipes-support/swupdate/files/defconfig
```kconfig
#
# Home Monitor OS — SWUpdate Configuration (ADR-0008)
#
CONFIG_HAVE_DOT_CONFIG=y

#
# General
#
CONFIG_DEFAULT_CONFIG_FILE="/etc/swupdate.cfg"
CONFIG_SCRIPTS=y
CONFIG_HW_COMPATIBILITY=y
CONFIG_HW_COMPATIBILITY_FILE="/etc/hwrevision"
CONFIG_SW_VERSIONS_FILE="/etc/sw-versions"

#
# Socket Paths
#
CONFIG_SOCKET_CTRL_PATH=""
CONFIG_SOCKET_PROGRESS_PATH=""
CONFIG_SOCKET_REMOTE_HANDLER_DIRECTORY="/tmp/"

#
# Handlers
#
CONFIG_RAW=y
CONFIG_SHELLSCRIPTHANDLER=y
CONFIG_ARCHIVE=y

#
# U-Boot integration (A/B switching)
#
CONFIG_BOOTLOADER_DEFAULT_UBOOT=y
CONFIG_UBOOT=y
CONFIG_UBOOT_FWENV="/etc/fw_env.config"

#
# Systemd
#
CONFIG_SYSTEMD=y

#
# Build
#
CONFIG_CROSS_COMPILE=""
CONFIG_SYSROOT=""
CONFIG_EXTRA_LDLIBS=""

#
# Disable unneeded features (keep binary small for Zero 2W)
#
# CONFIG_CURL is not set
# CONFIG_CURL_SSL is not set
# CONFIG_MTD is not set
# CONFIG_LUA is not set
# CONFIG_FEATURE_SYSLOG is not set
# CONFIG_SURICATTA is not set
# CONFIG_WEBSERVER is not set
# CONFIG_MONGOOSE is not set
# CONFIG_SIGNED_IMAGES is not set
# CONFIG_RDIFFHANDLER is not set
```

## meta-home-monitor/wic/home-camera-ab.wks
```
# Partition layout for RPi Zero 2W Camera Node (A/B OTA)
#
# Target SD card: 64 GB (minimum 32 GB)
#
# Part 1: boot    (512MB, vfat)  - U-Boot, kernel, DTBs, config.txt, U-Boot env
# Part 2: rootfsA (8GB, ext4)    - active root filesystem
# Part 3: rootfsB (8GB, ext4)    - standby root (OTA target)
# Part 4: data    (4GB, ext4)    - config, certs, updates
#
# Note: data partition is created at 4GB and expanded to fill the SD card
# on first boot by first-boot-setup.service (via resize2fs).

part /boot --source bootimg-partition --ondisk mmcblk0 --fstype=vfat --label boot --active --align 4096 --size 512M
part / --source rootfs --ondisk mmcblk0 --fstype=ext4 --label rootfsA --align 4096 --size 8192M
part --ondisk mmcblk0 --fstype=ext4 --label rootfsB --align 4096 --size 8192M
part /data --ondisk mmcblk0 --fstype=ext4 --label data --align 4096 --size 4096M
```

## meta-home-monitor/wic/home-monitor-ab.wks
```
# Partition layout for RPi 4B Home Monitor Server (A/B OTA)
#
# Target SD card: 64 GB (minimum 32 GB)
#
# Part 1: boot    (512MB, vfat)  - U-Boot, kernel, DTBs, config.txt, U-Boot env
# Part 2: rootfsA (8GB, ext4)    - active root filesystem
# Part 3: rootfsB (8GB, ext4)    - standby root (OTA target)
# Part 4: data    (remaining)    - recordings, config, certs, logs, updates (LUKS in production)
#
# On 64 GB card: /data gets ~47 GB
# On 32 GB card: /data gets ~15 GB
#
# rootfs image is built at content size (~600MB) and expanded via resize2fs
# on first boot to fill the 8GB partition. OTA writes the compact image to
# the inactive slot, then resize2fs runs during health-check confirmation.

part /boot --source bootimg-partition --ondisk mmcblk0 --fstype=vfat --label boot --active --align 4096 --size 512M
part / --source rootfs --ondisk mmcblk0 --fstype=ext4 --label rootfsA --align 4096 --size 8192M
part --ondisk mmcblk0 --fstype=ext4 --label rootfsB --align 4096 --size 8192M
part /data --ondisk mmcblk0 --fstype=ext4 --label data --align 4096 --grow
```
